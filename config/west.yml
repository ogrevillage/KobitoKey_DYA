## config/west.yml
```yaml
manifest:
  remotes:
    - name: zmkfirmware
      url-base: https://github.com/zmkfirmware
    - name: badjeff
      url-base: https://github.com/badjeff
    - name: hsgw
      url-base: https://github.com/hsgw
    - name: caksoylar  # <-- led
      url-base: https://github.com/caksoylar  
    - name: kot149
      url-base: https://github.com/kot149
    - name: te9no
      url-base: https://github.com/te9no
    - name: cormoran
      url-base: https://github.com/cormoran
  projects:
    - name: zmk
      remote: cormoran
      revision: v0.3-branch+dya
      import: app/west.yml

    - name: zmk-pmw3610-driver
      remote: badjeff
      revision: zmk-0.3
    
    - name: zmk-feature-sensor_rotation
      remote: hsgw
      revision: main

    - name: zmk-rgbled-widget  # <-- led
      remote: caksoylar
      revision: v0.3
      
    - name: zmk-layout-shift
      remote: kot149
      revision: v1

    - name: zmk-input-processor-keybind
      remote: te9no
      revision: main

    - name: zmk-module-runtime-input-processor
      remote: cormoran
      revision: zmk-v0.3.0.0

    - name: zmk-module-battery-history
      remote: cormoran
      revision: main

    - name: zmk-module-ble-management
      remote: cormoran
      revision: zmk-v0.3.0.0

    - name: zmk-module-settings-rpc
      remote: cormoran
      revision: main
  self:
    path: config
```
